## app/Kconfig
```kconfig
#
# Copyright (c) 2018 Nordic Semiconductor
#
# SPDX-License-Identifier: LicenseRef-BSD-5-Clause-Nordic
#

rsource "src/flash/Kconfig"
rsource "src/sensors/Kconfig"
rsource "src/lorawan/Kconfig"
rsource "src/bt_module/Kconfig"
rsource "src/outdoor_detection/Kconfig"
rsource "src/lp0/Kconfig"

menu "Zephyr Kernel"
source "$ZEPHYR_BASE/Kconfig.zephyr"
endmenu

menu "Size configs"
config BT_NUS_BUFFER_SIZE
	int "UART payload buffer element size"
	default 250
	help
	  Size of the payload buffer in each RX and TX FIFO element

config THREAD_MAIN_STACKSIZE
    int "Stacksize of the main thread"
    default 4096

config THREAD_SENSORS_STACKSIZE
    int "Stacksize of the sensor thread"
    default 4096

config THREAD_LORA_STACKSIZE
    int "Stacksize of the lora thread"
    default 4096

config THREAD_BLE_READ_STACKSIZE
    int "Stacksize of the ble receive message thread"
    default 1024

config THREAD_BLE_WRITE_STACKSIZE
    int "Stacksize of the ble send message thread"
    default 1024

config THREAD_FLASH_STACKSIZE
    int "Stacksize of the flash thread"
    default 2048

config THREAD_SATELLITE_STACKSIZE
    int "Stacksize of the satellite thread"
    default 4096

config THREAD_PRIORITY
    int "Thread priority"
    default 7

endmenu

menu "Low power configs"

config LOW_POWER
    bool "Enable low power mode"
    default y
    select PM
    # select SYS_PM_STATE_LOCK
    select DEVICE_POWER_MANAGEMENT
    select PM_DEVICE
    select PM_DEVICE_RUNTIME
    select PM_DEBUG

config DEBUG_MODE
    bool "Enable debug mode"
    default n
    select PRINTK
    select LOG
    select LOG_MODE_OVERFLOW
    select LOG_PRINTK
    select CONSOLE

choice
    prompt "Operation debug mode"
    optional
    help
      Specify debug mode: serial/RTT

config DEBUG_MODE_RTT
    bool "Debug mode using RTT backend"
    select DEBUG_MODE
    select RTT_CONSOLE
    select USE_SEGGER_RTT

config DEBUG_MODE_SERIAL
    bool "Debug mode using serial backend"
    select DEBUG_MODE
    select UART_CONSOLE
    select LOG_BACKEND_UART
endchoice

config PROVISIONING_MODE
    bool "Enable provisioning mode"
    default n

choice
    prompt "Operation test mode"
    optional
    help
       Specify operation test mode: serial/RTT.

config OPERATION_TEST_RTT
    bool "Operation test on RTT"
    select PRINTK
    select CONSOLE
    select RTT_CONSOLE
    select USE_SEGGER_RTT
    select SHELL
    select SHELL_BACKEND_RTT
    select PROVISIONING_MODE

config OPERATION_TEST_SERIAL
    bool "Operation test on serial"
    select PRINTK
    select CONSOLE
    select UART_CONSOLE
    select SHELL
    select SHELL_BACKEND_SERIAL
    select PROVISIONING_MODE

endchoice

endmenu
```

## app/src/bt_module/bt_cmdq/Kconfig
```kconfig
menu "BT_CMDQ"

config BT_CMDQ
    bool "Enable Bluetooth CMDQ module"
    default y
    help
        Enable the Bluetooth Cardiac monitoring device Q (CMDQ) module.

endmenu
```

## app/src/flash/Kconfig
```kconfig
# COPYRIGHT NOTICE: (c) 2022 Irnas. All rights reserved.

menuconfig FLASH_MODULE
    bool "Flash config options"
    # Enable UART driver
    depends on SPI && !MCUBOOT
    default n
    select SPI_FLASH_EN25
    select FLASH
    select FLASH_PAGE_LAYOUT
```

## app/src/lorawan/Kconfig
```kconfig
module = LORAWAN
module-str = lorawan wrapper
source "subsys/logging/Kconfig.template.log_config"
```

## app/src/lorawan/lr_s_band/Kconfig
```kconfig
menuconfig LR_S_BAND
    bool "LR_S_BAND"
    default n
    help
      This option enables the LR_S_BAND driver support.

if LR_S_BAND

module = LR_S_BAND_MODULE
module-str = lr_s_band_module
source "subsys/logging/Kconfig.template.log_config"

endif # LR_S_BAND
```

## app/src/lorawan/wifi_scan/Kconfig
```kconfig
menuconfig LR_WIFI_SCAN
    bool "LR_WIFI_SCAN"
    depends on LR11XX_LIB
    default n
    help
      This option enables the LR_WIFI_SCAN driver support.
      This driver is used to scan the available WiFi networks.

if LR_WIFI_SCAN

config LR_WIFI_SCAN_MODE
    int "LR_WIFI_SCAN_MODE"
    default 2
    help
      This option sets the LR_WIFI_SCAN mode.
      1: LR11XX_WIFI_SCAN_MODE_BEACON
      2: LR11XX_WIFI_SCAN_MODE_BEACON_AND_PKT
      4: LR11XX_WIFI_SCAN_MODE_FULL_BEACON
      5: LR11XX_WIFI_SCAN_MODE_UNTIL_SSID

config LR_WIFI_SCAN_RESULT_FORMAT
    int "LR_WIFI_SCAN_RESULT_FORMAT"
    default 0
    help
      This option sets the LR_WIFI_SCAN result format.
      0: LR11XX_WIFI_RESULT_FORMAT_BASIC_COMPLETE
      1: LR11XX_WIFI_RESULT_FORMAT_BASIC_MAC_TYPE_CHANNEL
      2: LR11XX_WIFI_RESULT_FORMAT_EXTENDED_FULL

config LR_WIFI_SCAN_SIGNAL_TYPE
    int "LR_WIFI_SCAN_SIGNAL_TYPE"
    default 4
    help
      This option sets the LR_WIFI_SCAN signal type.
      1: LR11XX_WIFI_TYPE_SCAN_B
      2: LR11XX_WIFI_TYPE_SCAN_G
      3: LR11XX_WIFI_TYPE_SCAN_N
      4: LR11XX_WIFI_TYPE_SCAN_B_G_N

config LR_WIFI_SCAN_CHANNEL_MASK
    int "LR_WIFI_SCAN_CHANNEL_MASK"
    default 16383
    help
      This option sets the LR_WIFI_SCAN channel mask.
      It is expressed as 16 bits mask of channels. 0x3FFF - all channels.

config LR_WIFI_SCAN_MAX_RESULTS
    int "LR_WIFI_SCAN_MAX_RESULTS"
    default 12
    help
      This option sets the LR_WIFI_SCAN max results.
      Max is 32.

config LR_WIFI_SCAN_NB_SCAN_PER_CHANNEL
    int "LR_WIFI_SCAN_NB_SCAN_PER_CHANNEL"
    default 2
    help
      This option sets the number of scans per channel.

config LR_WIFI_SCAN_TIMEOUT_PER_SCAN_MS
    int "LR_WIFI_SCAN_TIMEOUT_PER_SCAN_MS"
    default 110
    help
      This option sets the timeout per scan in ms.

config LR_WIFI_SCAN_ABORT_ON_TIMEOUT
    bool "LR_WIFI_SCAN_ABORT_ON_TIMEOUT"
    default y
    help
      Indicate if scan on one channel should stop on the first preamble search timeout detected.

module = LR_WIFI_SCAN
module-str = lr_wifi_scan
source "subsys/logging/Kconfig.template.log_config"

endif # LR_WIFI_SCAN
```

## app/src/lp0/Kconfig
```kconfig
module = LP0
module-str = lp0 wrapper
source "subsys/logging/Kconfig.template.log_config"

rsource "lp0_offload/Kconfig"

# LUKATODO:TODO-FUTURE: add KCONFIG FOR SD CARD WRITER SUPPORT AND ADD IT TO BOARD DEFCONFIG
```

## app/src/mic/Kconfig
```kconfig
# Copyright (c) 2024 IRNAS Ltd
# SPDX-License-Identifier: Apache-2.0

rsource "vm3011/Kconfig"
rsource "vm1010/Kconfig"
rsource "t5838/Kconfig"

menuconfig ENABLE_MIC
    bool "Device Mic"
    default n
    help
        Enable mic support. Selected by VM1010, VM3011 or T5838 config.
```

## app/src/mic/t5838/Kconfig
```kconfig
# Copyright (c) 2024 IRNAS Ltd
# T5838 Digital Microphone

menuconfig T5838
	bool "T5838 mic"
	default n
    depends on I2C
    select ENABLE_MIC
	help
	  Enable driver for T5838 Microphone.

if T5838

config T5838_CHANNELS
	int "Number of channels"
	default 1
	range 1 2
	help
	  Configure the number of microphone channels. 1 = Mono, 2 = Stereo.

config T5838_SAMPLE_RATE
	int "Sampling frequency"
	default 16000
	range 12400 50000
	help
	  Set the microphones sampling frequency.

config T5838_READ_TIMEOUT
	int "Block reading timeout (ms)"
	default 1000
	range 1 1000
	help
	  Set the number of milliseconds to wait before reading a block of data. For optimal performance and data overflow avoidance change this setting along with the BLOCK_COUNT setting.

config T5838_BLOCK_COUNT
	int "Number of memory blocks"
	default 4
	help
	  Set the number of memory blocks allocated for storing the sampled data. The size of each block is calculated based on the sampling rate and number of channels. Increasing this means that a longer sound recording can be made, but more RAM will be used.

endif #T5838
```

## app/src/mic/vm1010/Kconfig
```kconfig
# VM3011 Digital MEMS Microphone


menuconfig VM1010
	bool "VM1010 mic"
	default n
    depends on I2C
    select ENABLE_MIC
	help
	  Enable driver for VM1010 analog Microphone.
```

## app/src/outdoor_detection/Kconfig
```kconfig
menuconfig OUTDOOR_DETECTION
    bool "Outdoor detection module"
    default y
    help
        Enable the outdoor detection module for detecting if the device is outdoors or indoors.
```

## app/src/satellite/Kconfig
```kconfig
# COPYRIGHT NOTICE: (c) 2022 Irnas. All rights reserved.

menuconfig SATELLITE
    bool "Satellite communication module"
    default n
    depends on BOARD_RANGEREDGE_NRF52840 || BOARD_RANGEREDGE_AIRQ_NRF52840 || BOARD_FREEEDGE_NRF52840
```

## app/src/sensors/Kconfig
```kconfig
# COPYRIGHT NOTICE: (c) 2022 Irnas. All rights reserved.
rsource "lis2dw12_sensor/Kconfig"
rsource "air_quality/Kconfig"

menuconfig SENSORS_MODULE
    bool "Sensors config options"
    default n
    select GPIO
    select I2C
    select SENSOR
    select NRFX_TEMP
    select TEMP_NRF5
```

## app/src/sensors/air_quality/Kconfig
```kconfig
# COPYRIGHT NOTICE: (c) 2025 Irnas. All rights reserved.

menuconfig AIR_QUALITY
    bool "Air Quality Module"
    default y
    depends on BOARD_RANGEREDGE_AIRQ_NRF52840
```

## app/src/sensors/fence_port/common/Kconfig
```kconfig
# COPYRIGHT NOTICE: (c) 2022 Irnas. All rights reserved.

menuconfig FENCE_PORT
    bool "Fence port module"
    default n
    depends on BOARD_RANGEREDGE_NRF52840 || BOARD_RANGEREDGE_AIRQ_NRF52840
    depends on !MCUBOOT
    select ADC
```

## app/src/sensors/lis2dw12_sensor/Kconfig
```kconfig
# COPYRIGHT NOTICE: (c) 2022 Irnas. All rights reserved.

menuconfig LIS2DW12_SENSOR
    bool "lis2dw12 config options"
    depends on !MCUBOOT
    default n
    select GPIO
    select I2C
    select SENSOR
    # For some reason we cannot have config selection there,a s we cannot make it work with MCUBOOT
    #select IRNAS_LIS2DW12
    #select IRNAS_LIS2DW12_TRIGGER_GLOBAL_THREAD
    #select IRNAS_LIS2DW12_MOTION_DETECTION
    #select SENSOR_LOG_LEVEL_DBG
```

## boards/arm/collaredge_nrf52840/collaredge_nrf52840_defconfig
```kconfig
# SPDX-License-Identifier: Apache-2.0

CONFIG_SOC_SERIES_NRF52X=y
CONFIG_SOC_NRF52840_QIAA=y
CONFIG_BOARD_COLLAREDGE_NRF52840=y

# Enable MPU
CONFIG_ARM_MPU=y

# enable GPIO
CONFIG_GPIO=y

#sensors
CONFIG_LIS2DW12_SENSOR=y
CONFIG_IRNAS_LIS2DW12=y
CONFIG_IRNAS_LIS2DW12_TRIGGER_GLOBAL_THREAD=y
#CONFIG_IRNAS_LIS2DW12_FREE_FALL=y
#CONFIG_IRNAS_LIS2DW12_TAP=y
CONFIG_IRNAS_LIS2DW12_MOTION_DETECTION=y
CONFIG_SENSOR_LOG_LEVEL_DBG=n

# Battery
CONFIG_NFCT_PINS_AS_GPIOS=y

# Pin control
CONFIG_PINCTRL=y

# WiFi scan
CONFIG_LR_WIFI_SCAN=y
```

## boards/arm/freeedge_nrf52840/Kconfig
```kconfig
# nRF52840 DK NRF52840 board configuration

# Copyright (c) 2016 Nordic Semiconductor ASA
# SPDX-License-Identifier: Apache-2.0

rsource "../../../app/src/satellite/Kconfig"
rsource "../../../app/src/sensors/Kconfig"
rsource "../../../app/src/lorawan/lr_s_band/Kconfig"
rsource "../../../app/src/lorawan/wifi_scan/Kconfig"

config BOARD_ENABLE_DCDC
	bool "Enable DCDC mode"
	select SOC_DCDC_NRF52X
	default y
	depends on BOARD_FREEEDGE_NRF52840
```

## boards/arm/rangeredge_airq_nrf52840/rangeredge_airq_nrf52840_defconfig
```kconfig
# SPDX-License-Identifier: Apache-2.0

CONFIG_SOC_SERIES_NRF52X=y
CONFIG_SOC_NRF52840_QIAA=y
CONFIG_BOARD_RANGEREDGE_AIRQ_NRF52840=y

# Enable MPU
CONFIG_ARM_MPU=y

# Enable GPIO
CONFIG_GPIO=y

# sensors
# For some reason we must have config selection there, as we cannot make it work with MCUBOOT in sensors KConfig file
# EvaTODO - we want to remove that!
CONFIG_LIS2DW12_SENSOR=y
CONFIG_IRNAS_LIS2DW12=y
CONFIG_IRNAS_LIS2DW12_TRIGGER_GLOBAL_THREAD=y
# CONFIG_IRNAS_LIS2DW12_FREE_FALL=y
# CONFIG_IRNAS_LIS2DW12_TAP=y
CONFIG_IRNAS_LIS2DW12_MOTION_DETECTION=y
CONFIG_SENSOR_LOG_LEVEL_DBG=n

# Battery
CONFIG_NFCT_PINS_AS_GPIOS=y

# Pin control
CONFIG_PINCTRL=y

# WiFi scan
CONFIG_LR_WIFI_SCAN=y

CONFIG_FP_HARDABI=y
CONFIG_FPU=y

CONFIG_NEWLIB_LIBC=y
CONFIG_NEWLIB_LIBC_NANO=y
CONFIG_ERRNO=y

CONFIG_MAIN_STACK_SIZE=50000
CONFIG_SENSOR=y
CONFIG_SERIAL=y
CONFIG_I2C=y

# Enable BME68X driver
CONFIG_IRNAS_BME69X=y

# Enable BMV080 driver
CONFIG_IRNAS_BMV080=y

# BSEC library configuration - start
CONFIG_BSEC_LIB=y

####################################################
# Disable all features we do not use to save space #
####################################################

# Lorawan: Enable only EU868 region
CONFIG_LORA_BASICS_MODEM_REGION_EU_868=y

# Lorawan: Disable all other regions
CONFIG_LORA_BASICS_MODEM_ENABLE_ALL_REGIONS=n

# Disable CMDQ
CONFIG_BT_CMDQ=n

# Disable Outdoor detection
CONFIG_OUTDOOR_DETECTION=n

# Enable SDFS UART module (external SD card over UART)
CONFIG_SDFS_UART_MODULE=y
```

## boards/arm/rangeredge_nrf52840/Kconfig
```kconfig
# nRF52840 DK NRF52840 board configuration

# Copyright (c) 2016 Nordic Semiconductor ASA
# SPDX-License-Identifier: Apache-2.0

rsource "../../../app/src/satellite/Kconfig"
rsource "../../../app/src/sensors/fence_port/common/Kconfig"
rsource "../../../app/src/sensors/Kconfig"
rsource "../../../app/src/lorawan/wifi_scan/Kconfig"
rsource "../../../app/src/lorawan/lr_s_band/Kconfig"


config BOARD_ENABLE_DCDC
	bool "Enable DCDC mode"
	select SOC_DCDC_NRF52X
	default y
	depends on BOARD_RANGEREDGE_NRF52840


menu "mic"
    rsource "../../../app/src/mic/Kconfig"

    config MIC_VM3011_PDM
        bool "Select configs for PDM"
        depends on !MCUBOOT
        select AUDIO
        select AUDIO_DMIC
        select AUDIO_DMIC_NRFX_PDM
        select NRFX_PDM
        default n
        help
	        "Select PDM configs"

endmenu
```

## boards/arm/rangeredge_nrf52840/rangeredge_nrf52840_defconfig
```kconfig
# SPDX-License-Identifier: Apache-2.0

CONFIG_SOC_SERIES_NRF52X=y
CONFIG_SOC_NRF52840_QIAA=y
CONFIG_BOARD_RANGEREDGE_NRF52840=y

# Enable MPU
CONFIG_ARM_MPU=y

# enable GPIO
CONFIG_GPIO=y

# sensors
# For some reason we must have config selection there, as we cannot make it work with MCUBOOT in sensors KConfig file
# EvaTODO - we want to remove that!
CONFIG_LIS2DW12_SENSOR=y
CONFIG_IRNAS_LIS2DW12=y
CONFIG_IRNAS_LIS2DW12_TRIGGER_GLOBAL_THREAD=y
#CONFIG_IRNAS_LIS2DW12_FREE_FALL=y
#CONFIG_IRNAS_LIS2DW12_TAP=y
CONFIG_IRNAS_LIS2DW12_MOTION_DETECTION=y
CONFIG_SENSOR_LOG_LEVEL_DBG=n

# Battery
CONFIG_NFCT_PINS_AS_GPIOS=y

# Pin control
CONFIG_PINCTRL=y

# WiFi scan
CONFIG_LR_WIFI_SCAN=y

# Enable SDFS UART module (external SD card over UART)
CONFIG_SDFS_UART_MODULE=y
```

## boards/arm/rhinopuck35_nrf52840/Kconfig.board
```kconfig
# nRF52840 DK NRF52840 board configuration

# Copyright (c) 2016 Nordic Semiconductor ASA
# SPDX-License-Identifier: Apache-2.0

config BOARD_RHINOPUCK35_NRF52840
	bool "RHINOPUCK 35 NRF52840"
	depends on SOC_NRF52840_QIAA
```

## boards/arm/rhinopuck35_nrf52840/Kconfig.defconfig
```kconfig
# nRF52840 DK NRF52840 board configuration

# Copyright (c) 2016 Nordic Semiconductor ASA
# SPDX-License-Identifier: Apache-2.0

if BOARD_RHINOPUCK35_NRF52840

config BOARD
	default "rhinopuck35_nrf52840"

if USB

config USB_NRFX
	default y

config USB_DEVICE_STACK
	default y

endif # USB

config IEEE802154_NRF5
	default y
	depends on IEEE802154

config BT_CTLR
	default BT

endif # BOARD_RHINOPUCK35_NRF52840
```

## boards/arm/rhinopuck_nrf52840/Kconfig.defconfig
```kconfig
# nRF52840 DK NRF52840 board configuration

# Copyright (c) 2016 Nordic Semiconductor ASA
# SPDX-License-Identifier: Apache-2.0

if BOARD_RHINOPUCK_NRF52840

config BOARD
	default "rhinopuck_nrf52840"

if USB

config USB_NRFX
	default y

config USB_DEVICE_STACK
	default y

endif # USB

config IEEE802154_NRF5
	default y
	depends on IEEE802154

config BT_CTLR
	default BT

endif # BOARD_RHINOPUCK_NRF52840
```
