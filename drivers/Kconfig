## drivers/rf_front_end_module/Kconfig
```kconfig
menuconfig RF_FRONT_END_MODULE
    bool "RF_FRONT_END_MODULE"
    default n
    help
      This option enables the RF_FRONT_END_MODULE driver support.

if RF_FRONT_END_MODULE

module = RF_FRONT_END_MODULE
module-str = rf_front_end_module
source "subsys/logging/Kconfig.template.log_config"

endif # RF_FRONT_END_MODULE
```

## dts/bindings/sdfs.yaml
```yaml
# Copyright (c) 2023, IRNAS d.o.o.
# SPDX-License-Identifier: Apache-2.0

description: |
  AK-SDFS-UART module communication interface.

compatible: "irnas,ak-sdfs-uart"

include: "uart-device.yaml"

properties:
  reset-gpios:
    type: phandle-array
    required: true
    description: |
      GPIO connected to the reset pin of the AK-SDFS-UART module.
      This pin must be active-low as required by the AK-SDFS-UART module
      (>5 ms pulse to trigger).
```

## lib/Kconfig
```kconfig
rsource "lora_irq_handler/Kconfig"
rsource "lp0_communication/Kconfig"
rsource "lorawan_tools/Kconfig"
rsource "sdfs_uart/Kconfig"
```

## lib/lora_irq_handler/Kconfig
```kconfig
menuconfig LORA_IRQ_HANDLER
  bool "Enable IRQ thread"

if LORA_IRQ_HANDLER

config LORA_IRQ_HANDLER_STACK_SIZE
  int "IRQ thread stack size"
  default 1024
  help
	Stack size for the IRQ handling thread.

config LORA_IRQ_HANDLER_PRIORITY
  int "IRQ thread priority"
  default 10
  help
	Priority for the IRQ handling thread.

endif # LORA_IRQ_HANDLER
```

## lib/lorawan_tools/Kconfig
```kconfig
menuconfig LORAWAN_TOOLS
  bool "Enable LoRaWAN tools"
  help
    Enable LoRaWAN tools for building and parsing lora packets.
```

## lib/lp0_communication/Kconfig
```kconfig
menuconfig LP0_COMMUNICATION
  bool "Enable LP0 communication"
  select LORA_IRQ_HANDLER
  select LORAWAN_TOOLS
```

## lib/sdfs_uart/Kconfig
```kconfig
menuconfig SDFS_UART_MODULE
    bool "SDFS UART Handler Library"
    select SERIAL
    select UART_USE_RUNTIME_CONFIGURE
    help
      Enables the SDFS UART module.

if SDFS_UART_MODULE

config SDFS_UART_MODULE_INIT_PRIORITY
    int "SDFS UART Module Init Priority"
    default 80
    help
      Set the initialization priority of the SDFS UART module. This priority must be higher than the peripheral power initialization priority to ensure proper operation.

endif
```

## tests/charging_voltage_adjustment_test/testcase.yaml
```yaml
tests:
  tests.charging_voltage_adjustment_test.posix:
    # Set of platforms that this test case can be run on.
    platform_allow: native_posix
    harness: ztest
    # Only build the test, do not run it
    # build_only: True
    extra_configs:
      # Disable fancy test, otherwise stdout parsing does not work.
      - CONFIG_FANCY_ZTEST=n
```

## tests/outdoor_detection_test/testcase.yaml
```yaml
tests:
  tests.outdoor_detection.target:
    # Set of platforms that this test case can be run on.
    platform_allow: native_posix rhinoedge_nrf52840 rangeredge_nrf52840 rhinopuck_nrf52840 rhinopuck35_nrf52840 collaredge_nrf52840 freeedge_nrf52840
    harness: ztest
    # Only build the test, do not run it
    # build_only: True
    extra_configs:
      # Disable fancy test, otherwise stdout parsing does not work.
      - CONFIG_FANCY_ZTEST=n
      # See https://github.com/zephyrproject-rtos/zephyr/issues/39216 to learn
      # why this flag is needed here.
```

## west.yml
```yaml
manifest:
  self:
    # This repository should be cloned to
    path: project

  remotes:
    - name: nrfconnect
      url-base: https://github.com/nrfconnect
    - name: irnas
      url-base: https://github.com/irnas

  projects:
    # the NCS repository
    - name: nrf
      repo-path: sdk-nrf
      remote: nrfconnect
      # IMPORTANT: When changing NCS revision you need to change revision of
      # Zephyr project below so it matches.
      revision: v2.2.0
      import:
        name-allowlist:
          # Ignore NCS private repos, keep this list sorted alphabetically.
          # - ant
          # - azure-sdk-for-c
          # - cirrus
          # - cjson
          # - cmock
          # - find-my
          # - homekit
          # - matter
          # - mbedtls-nrf
          - mcuboot
          # - memfault-firmware-sdk
          # - nrf-802154
          - nrfxlib
          # - openthread
          # - sdk-hostap
          - tfm-mcuboot
          - trusted-firmware-m
          # Ignore zephyr repo as it is added below manually
          # - zephyr

    - name: zephyr
      remote: nrfconnect
      repo-path: sdk-zephyr
      revision: v3.2.99-ncs1
      import:
        # In addition to the zephyr repository itself, NCS also
        # imports the contents of zephyr/west.yml at the above
        # revision. Only the projects explicitly named in the
        # following allowlist are imported.
        #
        # Note that the zephyr west extensions (like 'build', 'flash',
        # 'debug', etc.) are automatically provided by this import, so
        # there's no need to add a redundant west-commands: key for
        # the zephyr project.
        #
        # Please keep this list sorted alphabetically.
        name-allowlist:
          # - TraceRecorderSource
          # - canopennode
          # - chre
          - cmsis
          # - edtt
          # - fatfs
          # - fff
          - hal_nordic
          - hal_st # Hal for ST's sensors, not for MCU's
          # - hal_wurthelektronik
          # - liblc3
          # - libmetal
          # - littlefs
          # - loramac-node
          # - lvgl
          # - lz4
          # - mbedtls
          # - mipi-sys-t
          # - nanopb
          # - net-tools
          - nrf_hw_models
          # - open-amp
          # - picolibc
          # - psa-arch-tests
          - segger
          # - tinycbor
          - tinycrypt
          - tf-m-tests
          # - uoscore-uedhoc
          - zcbor
          # - zscilib
    # irnas drivers
    - name: zephyr-spi-flash-en25-driver
      repo-path: zephyr-spi-flash-en25-driver
      path: irnas/zephyr-spi-flash-en25-driver
      remote: irnas
      revision: v3.2.0
    - name: irnas-lis2dw12-driver
      repo-path: irnas-lis2dw12-driver
      path: irnas/irnas-lis2dw12-driver
      remote: irnas
      revision: v3.2.0
    - name: irnas-voltage-divider-driver
      repo-path: irnas-voltage-divider-driver
      path: irnas/irnas-voltage-divider-driver
      remote: irnas
      revision: v2.0.0
    - name: irnas-peripheral-power
      repo-path: peripheral-power
      path: irnas/peripheral-power
      remote: irnas
      revision: dev
    - name: irnas-versioninfo-lib
      repo-path: irnas-versioninfo-lib
      path: irnas/irnas-versioninfo-lib
      remote: irnas
      revision: v1.1.1
    - name: SWDR001-Zephyr
      repo-path: SWDR001-Zephyr
      path: irnas/SWDR001-Zephyr
      remote: irnas
      revision: v1.5.4
    - name: SWL2001-Zephyr
      repo-path: SWL2001-Zephyr
      path: irnas/SWL2001-Zephyr
      remote: irnas
      revision: v1.4.0
    - name: irnas-t5838-driver
      repo-path: irnas-t5838-driver
      path: irnas/irnas-t5838-driver
      remote: irnas
      revision: v0.1.0
    - name: irnas-bmv080-driver
      repo-path: irnas-bmv080-driver
      path: irnas/irnas-bmv080-driver
      remote: irnas
      revision: v1.0.1
    - name: irnas-bme690-driver
      repo-path: irnas-bme690-driver
      path: irnas/irnas-bme690-driver
      remote: irnas
      revision: v1.0.1
```
