## CMakeLists.txt
```
# SPDX-License-Identifier: Apache-2.0

cmake_minimum_required(VERSION 3.20.0)

set(BOARD_ROOT ${CMAKE_CURRENT_LIST_DIR}/../..)
# selects the board that the application’s
# build will use for the default configuration
set(BOARD rangeredge_nrf52840)

find_package(Zephyr HINTS $ENV{ZEPHYR_BASE})
project(blinky)

zephyr_compile_options(-fdiagnostics-color=always)

target_sources(app PRIVATE src/main.c)

# add include directories from application
add_subdirectory(../../app/src/sensors/fence_port/fence)
```

## prj.conf
```kconfig
# Enable printk
CONFIG_PRINTK=y
CONFIG_GPIO=y
CONFIG_SERIAL=y
CONFIG_CONSOLE=y
CONFIG_LOG=y
CONFIG_LOG_BUFFER_SIZE=8192


# UART config - change DT UART as well!
CONFIG_UART_CONSOLE=y

# RTT config
#CONFIG_UART_CONSOLE=n
#CONFIG_RTT_CONSOLE=y
#CONFIG_USE_SEGGER_RTT=y
#CONFIG_SEGGER_RTT_BUFFER_SIZE_UP=8192

# fence
CONFIG_FENCE=y
```

## src/main.c
```c
/*
 * Copyright (c) 2020 Irnas d.o.o.
 *
 * SPDX-License-Identifier: Apache-2.0
 */

#include <zephyr/devicetree.h>
#include <zephyr/drivers/gpio.h>
#include <zephyr/kernel.h>
#include <zephyr/logging/log.h>

LOG_MODULE_REGISTER(main);

#include "fence.h"

/* LED device */
static const struct gpio_dt_spec led = GPIO_DT_SPEC_GET(DT_NODELABEL(led_r), gpios);

void main(void)
{
	LOG_INF("Fence sample");

	/* Configure LED */
	if (!device_is_ready(led.port)) {
		return;
	}

	gpio_pin_configure_dt(&led, GPIO_OUTPUT_ACTIVE);

	fence_init();

	k_sleep(K_SECONDS(1));

	gpio_pin_set_dt(&led, 0);

	while (1) {

		fence_measure(10, 100000, NULL, NULL);
		k_msleep(1000);
	}
}
```
