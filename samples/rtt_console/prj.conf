## CMakeLists.txt
```
# SPDX-License-Identifier: Apache-2.0

cmake_minimum_required(VERSION 3.13.1)

set(BOARD_ROOT ${CMAKE_CURRENT_LIST_DIR}/../..)
# selects the board that the application’s
# build will use for the default configuration
set(BOARD rangeredge_nrf52840)

find_package(Zephyr HINTS $ENV{ZEPHYR_BASE})
project(blinky)

zephyr_compile_options(-fdiagnostics-color=always)

target_sources(app PRIVATE src/main.c)
```

## prj.conf
```kconfig
# Enable logging (it need to be disabled for low power)
CONFIG_PRINTK=y
CONFIG_GPIO=y
CONFIG_SERIAL=y
CONFIG_CONSOLE=y
# For this application disable logging
CONFIG_LOG=n
CONFIG_LOG_DEFAULT_LEVEL=4
#CONFIG_LOG_BACKEND_UART=y
#CONFIG_LOG_BACKEND_RTT=y

# enable shell, but disable its advanced features
CONFIG_SHELL=y

CONFIG_MAIN_STACK_SIZE=4096

# UART
# CONFIG_UART_CONSOLE=y
# CONFIG_RTT_CONSOLE=n
# CONFIG_SHELL_BACKEND_SERIAL=y

# RTT config
CONFIG_UART_CONSOLE=n
CONFIG_RTT_CONSOLE=y
CONFIG_USE_SEGGER_RTT=y
CONFIG_SHELL_BACKEND_RTT=y
```

## src/main.c
```c
/*
 * Copyright (c) 2020 Irnas d.o.o.
 *
 * SPDX-License-Identifier: Apache-2.0
 */

#include <zephyr/console/console.h>
#include <zephyr/device.h>
#include <zephyr/devicetree.h>
#include <zephyr/drivers/gpio.h>
#include <zephyr/kernel.h>
#include <zephyr/shell/shell.h>

#ifdef CONFIG_UART_CONSOLE
#include <zephyr/shell/shell_uart.h>
#endif // CONFIG_UART_CONSOLE

#ifdef CONFIG_RTT_CONSOLE
#include <zephyr/shell/shell_rtt.h>
#endif // CONFIG_RTT_CONSOLE

static int cmd_test1(const struct shell *shell, size_t argc, char **argv)
{
	ARG_UNUSED(argc);
	ARG_UNUSED(argv);

	shell_echo_set(shell, false);
	shell_print(shell, "Test 1");

	return 0;
}

static int cmd_test2(const struct shell *shell, size_t argc, char **argv)
{
	ARG_UNUSED(argc);
	ARG_UNUSED(argv);

	shell_print(shell, "Test 2");

	return 0;
}

void main(void)
{
	printk("Shell example\n");

#ifdef CONFIG_UART_CONSOLE
	shell_echo_set(shell_backend_uart_get_ptr(), false);
#endif // CONFIG_UART_CONSOLE
#ifdef CONFIG_RTT_CONSOLE
	shell_echo_set(shell_backend_rtt_get_ptr(), false);
#endif // CONFIG_RTT_CONSOLE
}

SHELL_CMD_REGISTER(TEST1, NULL, "Shell test 1", cmd_test1);
SHELL_CMD_REGISTER(TEST2, NULL, "Shell test 2", cmd_test2);
```
